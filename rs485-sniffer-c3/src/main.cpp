#include <Arduino.h>
#include <BLEDevice.h>
#include <BLEServer.h>
#include <BLEUtils.h>
#include <WiFi.h>
#include <WebServer.h>
#include <ESPmDNS.h>
#include <DNSServer.h>
#include <Preferences.h>

// ─── PINY ────────────────────────────────────────────────
#define RS485_RE_PIN   3
#define RS485_DE_PIN   2
#define RS485_RX_PIN   4   // RO
#define RS485_TX_PIN   1   // DI
#define LED_PIN        8
#define BOOT_BUTTON    9

// ─── BLE UUID ────────────────────────────────────────────
#define SERVICE_UUID           "6E400001-B5A3-F393-E0A9-E50E24DCCA9E"
#define CHARACTERISTIC_UUID_RX "6E400002-B5A3-F393-E0A9-E50E24DCCA9E"
#define CHARACTERISTIC_UUID_TX "6E400003-B5A3-F393-E0A9-E50E24DCCA9E"

HardwareSerial RS485Serial(1);
WebServer server(80);
DNSServer dnsServer;
Preferences prefs;

bool bleActive = false;
bool apMode    = false;
uint32_t txCount = 0;
uint32_t rxCount = 0;
BLECharacteristic* pTxCharacteristic = nullptr;

// ─── RS485 FRAME ASSEMBLER ───────────────────────────────
#define FRAME_IDLE_MS   15
#define FRAME_BUF_SIZE  512
static uint8_t  frameBuf[FRAME_BUF_SIZE];
static uint16_t frameLen   = 0;
static uint32_t lastByteMs = 0;
static bool     frameActive = false;

// ─── SNIFFER RING BUFFER ─────────────────────────────────
#define SNIFF_FRAMES 32
struct SniffFrame {
    char     hex[FRAME_BUF_SIZE * 3 + 4];
    char     asc[FRAME_BUF_SIZE + 4];
    char     dir[3];
    uint32_t ms;
};
static SniffFrame sniffBuf[SNIFF_FRAMES];
static uint8_t sniffHead = 0;
static uint8_t sniffTail = 0;
static bool sniffEmpty() { return sniffHead == sniffTail; }
static bool sniffFull()  { return ((sniffHead+1) % SNIFF_FRAMES) == sniffTail; }

void sniffPush(const uint8_t* buf, size_t len, const char* dir) {
    if (!len || sniffFull()) return;
    SniffFrame& f = sniffBuf[sniffHead];
    int p = 0;
    for (size_t i = 0; i < len && i < FRAME_BUF_SIZE; i++) {
        if (i) f.hex[p++] = ' ';
        snprintf(f.hex + p, 4, "%02X", buf[i]);
        p += 2;
    }
    f.hex[p] = '\0';
    for (size_t i = 0; i < len && i < FRAME_BUF_SIZE; i++)
        f.asc[i] = (buf[i] >= 0x20 && buf[i] < 0x7F) ? (char)buf[i] : '.';
    f.asc[len < FRAME_BUF_SIZE ? len : FRAME_BUF_SIZE] = '\0';
    strncpy(f.dir, dir, 2); f.dir[2] = '\0';
    f.ms = millis();
    sniffHead = (sniffHead + 1) % SNIFF_FRAMES;
}

// ─── FORWARD DECLARATION ─────────────────────────────────
void sendToRS485(const uint8_t* data, size_t len);

// ─── BLE CALLBACKS ───────────────────────────────────────
class MyServerCallbacks : public BLEServerCallbacks {
    void onDisconnect(BLEServer* s) override { BLEDevice::startAdvertising(); }
};
class MyCallbacks : public BLECharacteristicCallbacks {
    void onWrite(BLECharacteristic* c) override {
        String v = c->getValue();
        if (v.length()) sendToRS485((const uint8_t*)v.c_str(), v.length());
    }
};

// ─── RS485 SEND ──────────────────────────────────────────
void sendToRS485(const uint8_t* data, size_t len) {
    if (!len) return;
    digitalWrite(LED_PIN, HIGH);
    digitalWrite(RS485_RE_PIN, HIGH);
    digitalWrite(RS485_DE_PIN, HIGH);
    delayMicroseconds(10);
    RS485Serial.write(data, len);
    RS485Serial.flush();
    delayMicroseconds(100);
    digitalWrite(RS485_DE_PIN, LOW);
    delayMicroseconds(10);
    digitalWrite(RS485_RE_PIN, LOW);
    digitalWrite(LED_PIN, LOW);
    txCount++;
    // Sniffer TX — zawsze aktywny
    sniffPush(data, len, "TX");
    // BLE notify — tylko gdy aktywne
    if (bleActive && pTxCharacteristic) {
        pTxCharacteristic->setValue((uint8_t*)data, len);
        pTxCharacteristic->notify();
    }
}

// ─── BLE LOG ─────────────────────────────────────────────
void bleLog(const char* msg) {
    if (!bleActive || !pTxCharacteristic) return;
    pTxCharacteristic->setValue((uint8_t*)msg, strlen(msg));
    pTxCharacteristic->notify();
    delay(20);
}

// ─── RESET BUTTON ────────────────────────────────────────
void checkResetButton() {
    if (digitalRead(BOOT_BUTTON) != LOW) return;
    unsigned long t = millis();
    while (digitalRead(BOOT_BUTTON) == LOW) {
        if (millis() - t > 5000) {
            for (int i=0;i<10;i++){
                digitalWrite(LED_PIN,HIGH);delay(100);
                digitalWrite(LED_PIN,LOW);delay(100);
            }
            prefs.begin("cfg", false);
            prefs.clear();
            prefs.end();
            delay(300);
            ESP.restart();
        }
    }
}

// HTML GUI GZIP 13698 B
const uint32_t index_html_gz_len = 13698;
const uint8_t index_html_gz[] PROGMEM = {
  0x1F, 0x8B, 0x08, 0x08, 0xD3, 0x19, 0xF8, 0x69, 0x02, 0x03, 0x70, 0x61, 0x67, 0x65, 0x5F, 0x76,
  0x33, 0x2E, 0x68, 0x74, 0x6D, 0x6C, 0x00, 0xBC, 0x3C, 0xDB, 0x76, 0xE3, 0x38, 0x72, 0xEF, 0xFD,
  0x15, 0x58, 0xF5, 0x99, 0x71, 0x3B, 0x6B, 0xD2, 0x24, 0x75, 0xB1, 0x2C, 0x5F, 0x76, 0x64, 0xB7,
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  0x00, 0x00
};

// ─── SETUP ───────────────────────────────────────────────
void setup() {
    pinMode(LED_PIN, OUTPUT);
    pinMode(BOOT_BUTTON, INPUT_PULLUP);
    digitalWrite(LED_PIN, HIGH);

    // RS485 piny — TX HIGH przed begin() żeby nie zaśmiecać magistrali
    pinMode(RS485_TX_PIN, OUTPUT);
    digitalWrite(RS485_TX_PIN, HIGH);
    pinMode(RS485_DE_PIN, OUTPUT);
    digitalWrite(RS485_DE_PIN, LOW);
    pinMode(RS485_RE_PIN, OUTPUT);
    digitalWrite(RS485_RE_PIN, LOW);

    RS485Serial.setRxBufferSize(2048);
    RS485Serial.begin(19200, SERIAL_8E1, RS485_RX_PIN, RS485_TX_PIN);

    // NVS
    prefs.begin("cfg", false);
    bleActive = prefs.getBool("ble", false);
    String wifi_ssid = prefs.getString("ssid", "");
    String wifi_pass = prefs.getString("pass", "");
    prefs.end();

    // WiFi
    WiFi.persistent(false);
    WiFi.disconnect(true);
    delay(100);

    if (wifi_ssid.length() > 0) {
        WiFi.mode(WIFI_STA);
        WiFi.setHostname("rs485-pro-ble");
        WiFi.begin(wifi_ssid.c_str(), wifi_pass.c_str());
        unsigned long t = millis();
        while (WiFi.status() != WL_CONNECTED && millis() - t < 10000) {
            delay(200);
            digitalWrite(LED_PIN, !digitalRead(LED_PIN));
        }
        if (WiFi.status() != WL_CONNECTED) {
            prefs.begin("cfg", false);
            prefs.putString("ssid", "");
            prefs.putString("pass", "");
            prefs.end();
            WiFi.mode(WIFI_AP);
            delay(100);
            WiFi.softAP("RS485_PRO_BLE", "12345678");
            dnsServer.start(53, "*", IPAddress(192,168,4,1));
            apMode = true;
        } else {
            digitalWrite(LED_PIN, LOW);
        }
    } else {
        WiFi.mode(WIFI_AP);
        delay(100);
        WiFi.softAP("RS485_PRO_BLE", "12345678");
        dnsServer.start(53, "*", IPAddress(192,168,4,1));
        apMode = true;
    }

    // mDNS
    if (MDNS.begin("rs485-pro-ble")) {
        MDNS.addService("http", "tcp", 80);
        MDNS.addServiceTxt("http", "tcp", "device", "RS485 Pro BLE");
    }

    // BLE
    if (bleActive) {
        BLEDevice::init("RS485 Pro BLE");
        BLEServer* pSrv = BLEDevice::createServer();
        pSrv->setCallbacks(new MyServerCallbacks());
        BLEService* pSvc = pSrv->createService(SERVICE_UUID);
        pTxCharacteristic = pSvc->createCharacteristic(
            CHARACTERISTIC_UUID_TX, BLECharacteristic::PROPERTY_NOTIFY);
        BLECharacteristic* pRx = pSvc->createCharacteristic(
            CHARACTERISTIC_UUID_RX, BLECharacteristic::PROPERTY_WRITE);
        pRx->setCallbacks(new MyCallbacks());
        pSvc->start();
        BLEDevice::startAdvertising();
    }

    // ─── ROUTES ──────────────────────────────────────────

    server.on("/", HTTP_GET, [](){
        server.sendHeader("Content-Encoding", "gzip");
        server.sendHeader("Cache-Control", "max-age=3600");
        server.setContentLength(index_html_gz_len);
        server.send(200, "text/html", "");
        server.client().write((const char*)index_html_gz, index_html_gz_len);
    });

    server.on("/api/status", HTTP_GET, [](){
        server.sendHeader("Access-Control-Allow-Origin", "*");
        String ip = (WiFi.status() == WL_CONNECTED)
                        ? WiFi.localIP().toString()
                        : WiFi.softAPIP().toString();
        int rssi = (WiFi.status() == WL_CONNECTED) ? WiFi.RSSI() : 0;
        char buf[300];
        snprintf(buf, sizeof(buf),
            "{\"ip\":\"%s\",\"rssi\":%d,\"tx\":%lu,\"rx\":%lu,"
            "\"ble\":%s,\"heap\":%lu,\"sta\":%s,\"mdns\":\"rs485-pro-ble.local\"}",
            ip.c_str(), rssi,
            (unsigned long)txCount, (unsigned long)rxCount,
            bleActive?"true":"false",
            (unsigned long)(ESP.getFreeHeap()/1024),
            (WiFi.status()==WL_CONNECTED)?"true":"false");
        server.send(200, "application/json", buf);
    });

    server.on("/api/send", HTTP_GET, [](){
        if (server.hasArg("msg")) {
            String m = server.arg("msg");
            sendToRS485((const uint8_t*)m.c_str(), m.length());
        }
        server.send(200, "application/json", "{\"ok\":true}");
    });

    // Sniffer polling — działa zawsze, niezależnie od BLE
    server.on("/api/frames", HTTP_GET, [](){
        server.sendHeader("Access-Control-Allow-Origin", "*");
        if (sniffEmpty()) {
            server.send(200, "application/json", "{\"frames\":[]}");
            return;
        }
        String json = "{\"frames\":[";
        bool first = true;
        int maxOut = 16;
        while (!sniffEmpty() && maxOut-- > 0) {
            SniffFrame& f = sniffBuf[sniffTail];
            sniffTail = (sniffTail + 1) % SNIFF_FRAMES;
            if (!first) json += ",";
            first = false;
            String asc = String(f.asc);
            asc.replace("\\", "\\\\");
            asc.replace("\"", "\\\"");
            json += "{\"dir\":\"";
            json += f.dir;
            json += "\",\"ms\":";
            json += f.ms;
            json += ",\"a\":\"";
            json += asc;
            json += "\",\"d\":\"";
            json += f.hex;
            json += "\"}";
        }
        json += "]}";
        server.send(200, "application/json", json);
    });

    server.on("/api/connect", HTTP_GET, [](){
        if (server.hasArg("ssid")) {
            String s = server.arg("ssid");
            String p = server.hasArg("pass") ? server.arg("pass") : "";
            prefs.begin("cfg", false);
            prefs.putString("ssid", s);
            prefs.putString("pass", p);
            prefs.end();
            server.send(200, "application/json", "{\"ok\":true}");
            delay(300); ESP.restart();
        } else {
            server.send(400, "application/json", "{\"ok\":false}");
        }
    });

    server.on("/api/ble", HTTP_GET, [](){
        prefs.begin("cfg", false);
        bool cur = prefs.getBool("ble", false);
        prefs.putBool("ble", !cur);
        prefs.end();
        server.send(200, "application/json", "{\"ok\":true}");
        delay(300); ESP.restart();
    });

    server.on("/api/save", HTTP_GET, [](){
        prefs.begin("cfg", false);
        if (server.hasArg("ble"))
            prefs.putBool("ble", server.arg("ble") == "1");
        prefs.end();
        server.send(200, "application/json", "{\"ok\":true}");
    });

    server.on("/api/reset", HTTP_GET, [](){
        server.send(200, "application/json", "{\"ok\":true}");
        prefs.begin("cfg", false); prefs.clear(); prefs.end();
        delay(300); ESP.restart();
    });

    // Captive portal — Android, iOS, Windows, Firefox, Chrome
    auto redir = [](){
        server.sendHeader("Location", "http://192.168.4.1/");
        server.send(302, "text/plain", "");
    };
    server.on("/generate_204",              HTTP_GET, redir);
    server.on("/gen_204",                   HTTP_GET, redir);
    server.on("/connecttest.txt",           HTTP_GET, redir);
    server.on("/ncsi.txt",                  HTTP_GET, redir);
    server.on("/hotspot-detect.html",       HTTP_GET, redir);
    server.on("/library/test/success.html", HTTP_GET, redir);
    server.on("/success.txt",               HTTP_GET, redir);
    server.on("/canonical.html",            HTTP_GET, redir);

    server.onNotFound([](){
        if (apMode) {
            server.sendHeader("Location", "http://192.168.4.1/");
            server.send(302, "text/plain", "");
        } else {
            server.send(404, "text/plain", "Not found");
        }
    });

    server.begin();
    digitalWrite(LED_PIN, LOW);

    // Logi startowe przez BLE (po 2s żeby klient zdążył się połączyć)
    if (bleActive) {
        delay(2000);
        char buf[80];
        bleLog("[SYS] RS485 Pro BLE start");
        bleLog("[SYS] RS485: 19200/8E1 RE=GPIO3 DE=GPIO2 RX=GPIO4 TX=GPIO1");
        if (WiFi.status() == WL_CONNECTED)
            snprintf(buf, sizeof(buf), "[SYS] WiFi STA: %s", WiFi.localIP().toString().c_str());
        else
            snprintf(buf, sizeof(buf), "[SYS] WiFi AP: RS485_PRO_BLE @ 192.168.4.1");
        bleLog(buf);
        bleLog("[SYS] HTTP OK | rs485-pro-ble.local");
    }
}

// ─── LOOP ────────────────────────────────────────────────
void loop() {
    checkResetButton();
    if (apMode) dnsServer.processNextRequest();
    server.handleClient();

    // RS485 RX — akumulacja z detekcją ciszy
    // USB COM9 jest CICHY — brak Serial.write — GID widzi czyste dane
    while (RS485Serial.available()) {
        uint8_t b = (uint8_t)RS485Serial.read();
        if (frameLen < FRAME_BUF_SIZE) frameBuf[frameLen++] = b;
        lastByteMs  = millis();
        frameActive = true;
    }

    if (frameActive && frameLen > 0 &&
        (millis() - lastByteMs) >= FRAME_IDLE_MS) {
        rxCount++;
        // Sniffer — zawsze aktywny
        sniffPush(frameBuf, frameLen, "RX");
        // BLE notify — tylko gdy aktywne
        if (bleActive && pTxCharacteristic) {
            pTxCharacteristic->setValue(frameBuf, frameLen);
            pTxCharacteristic->notify();
        }
        frameLen    = 0;
        frameActive = false;
    }
}
